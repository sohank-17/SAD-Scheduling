## hybrid-rtos-scheduler/SAD_Zephyr_Changes/hybrid_sched_test/build/Kconfig/arch/Kconfig
```kconfig
# Load Zephyr Arch Kconfig descriptions.
osource "/home/dylan/stuff/zephyrproject/zephyr/arch/rx/Kconfig"
osource "/home/dylan/stuff/zephyrproject/zephyr/arch/x86/Kconfig"
osource "/home/dylan/stuff/zephyrproject/zephyr/arch/xtensa/Kconfig"
osource "/home/dylan/stuff/zephyrproject/zephyr/arch/sparc/Kconfig"
osource "/home/dylan/stuff/zephyrproject/zephyr/arch/riscv/Kconfig"
osource "/home/dylan/stuff/zephyrproject/zephyr/arch/posix/Kconfig"
osource "/home/dylan/stuff/zephyrproject/zephyr/arch/mips/Kconfig"
osource "/home/dylan/stuff/zephyrproject/zephyr/arch/arm64/Kconfig"
osource "/home/dylan/stuff/zephyrproject/zephyr/arch/arm/Kconfig"
osource "/home/dylan/stuff/zephyrproject/zephyr/arch/arc/Kconfig"
```

## hybrid-rtos-scheduler/SAD_Zephyr_Changes/hybrid_sched_test/build/Kconfig/boards/Kconfig.defconfig
```kconfig
# Load Zephyr board defconfig descriptions.
osource "/home/dylan/stuff/zephyrproject/zephyr/boards/qemu/x86/Kconfig.defconfig"
```

## hybrid-rtos-scheduler/SAD_Zephyr_Changes/hybrid_sched_test/build/Kconfig/boards/Kconfig.sysbuild
```kconfig
# Load Sysbuild board Kconfig descriptions.
osource "/home/dylan/stuff/zephyrproject/zephyr/boards/qemu/x86/Kconfig.sysbuild"
```

## hybrid-rtos-scheduler/SAD_Zephyr_Changes/sched_mod/Kconfig.sched_diag
```kconfig
# Lightweight scheduler diagnostics (off by default)
menu "Scheduler diagnostics"
config SCHED_DIAG
    bool "Enable lightweight scheduler diagnostics"
    help
      Collects minimal counters (context switches, preemptions, ready-queue length)
      with negligible overhead. No kernel printing; data is exposed via a small API.
endmenu
```
